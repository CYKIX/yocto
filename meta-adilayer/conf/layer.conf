## meta-adilayer/conf/layer.conf
```bitbake
# meta-adilayer/conf/layer.conf

BBPATH .= ":${LAYERDIR}"
BBFILES += "${LAYERDIR}/recipes-*/*/*.bb \
            ${LAYERDIR}/recipes-*/*/*.bbappend"

# Compatible Yocto release name — change to your version
LAYERSERIES_COMPAT_meta-adilayer = "styhead"

LAYERDEPENDS_meta-adilayer = ""
```
